#include "../behavior_keymap.dtsi"

// Virtual index 6 is one past the last encoder direction and must be rejected.

&kscan {
    events = <
    // clear overrides persisted by an earlier run
    ZMK_MOCK_PRESS(1,1,10) ZMK_MOCK_RELEASE(1,1,10)
    ZMK_MOCK_PRESS(0,0,10) ZMK_MOCK_RELEASE(0,0,10)
    ZMK_MOCK_PRESS(1,0,10) ZMK_MOCK_RELEASE(1,0,10)
    ZMK_MOCK_PRESS(0,0,10) ZMK_MOCK_RELEASE(0,0,10)
    // layer 1, index 6 is out of range
    ZMK_MOCK_PRESS(1,1,10) ZMK_MOCK_RELEASE(1,1,10)
    ZMK_MOCK_PRESS(0,1,10) ZMK_MOCK_RELEASE(0,1,10)
    ZMK_MOCK_RELEASE(0,0,100)
    >;
};

&mock_encoder {
    events = <18>;
};
