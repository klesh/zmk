## app/boards/shields/ballkey_clunky/Kconfig.defconfig
```kconfig
# 第二个 Kconfig 文件：设定 shield 的配置项及默认值

if SHIELD_BALLKEY_CLUNKY # 有 if 判断，说明所有的 Kconfig 都会被遍历加载

config ZMK_KEYBOARD_NAME
    default "Ballkey Clunky"

if ZMK_DISPLAY

config I2C
    default y

config SSD1306
    default y

endif # ZMK_DISPLAY

if LVGL

config LV_Z_VDB_SIZE
    default 64

config LV_DPI_DEF
    default 148

config LV_Z_BITS_PER_PIXEL
    default 1

choice LV_COLOR_DEPTH
    default LV_COLOR_DEPTH_1
endchoice

endif # LVGL


endif
```

## app/boards/shields/ballue/Kconfig.defconfig
```kconfig
# 第二个 Kconfig 文件：设定 shield 的配置项及默认值

if SHIELD_BALLUE # 有 if 判断，说明所有的 Kconfig 都会被遍历加载

config ZMK_KEYBOARD_NAME
    default "ballue"

endif
```

## app/boards/shields/ballue/Kconfig.shield
```kconfig
# 第一个 Kconfig 文件：当 shields list 含有 ballue 时，产生一个 SHIELD_BALLUE=y 的 flag
config SHIELD_BALLUE
    def_bool $(shields_list_contains,ballue)
```

## app/boards/shields/cradiofs/Kconfig.defconfig
```kconfig
# Copyright (c) 2020 The ZMK Contributors
# SPDX-License-Identifier: MIT

if SHIELD_CRADIOFS_LEFT

config ZMK_KEYBOARD_NAME
    default "CradioFS"

config ZMK_SPLIT_ROLE_CENTRAL
    default y

endif

if SHIELD_CRADIOFS_LEFT || SHIELD_CRADIOFS_RIGHT

config ZMK_SPLIT
    default y

endif
```

## app/boards/shields/cradiofs/Kconfig.shield
```kconfig
# Copyright (c) 2020 The ZMK Contributors
# SPDX-License-Identifier: MIT

config SHIELD_CRADIOFS_LEFT
    def_bool $(shields_list_contains,cradiofs_left)

config SHIELD_CRADIOFS_RIGHT
    def_bool $(shields_list_contains,cradiofs_right)
```

## app/dts/bindings/behaviors/zmk,behavior-cycle-cpi.yaml
```yaml
# Copyright (c) 2020 The ZMK Contributors
# SPDX-License-Identifier: MIT

description: Cycling CPI Action

compatible: "zmk,behavior-cycle-cpi"

include: one_param.yaml

properties:
  device:
    type: phandle
    required: true
  sensor-channel:
    type: int
    required: false
    default: -1
  sensor-attr:
    type: int
    required: false
    default: -1
  cpis:
    type: array
    required: true
  initial-cpi-index:
    type: int
    required: true
    default: 0
```

## app/dts/bindings/input_processors/zmk,input-processor-thresholder.yaml
```yaml
# Copyright (c) 2024, The ZMK Contributors
# SPDX-License-Identifier: MIT

description: Input Processor for thresholding values

compatible: "zmk,input-processor-thresholder"

include: ip_one_param.yaml

properties:
  type:
    type: int
    required: true
  codes:
    type: array
    required: true
```

## app/src/display/widgets/Kconfig
```kconfig
# Copyright (c) 2020 The ZMK Contributors
# SPDX-License-Identifier: MIT

menu "ZMK Display Widgets"

config ZMK_WIDGET_LAYER_STATUS
    bool "Widget for highest, active layer using small icons"
    depends on !ZMK_SPLIT || ZMK_SPLIT_ROLE_CENTRAL
    select LV_USE_LABEL

config ZMK_WIDGET_BATTERY_STATUS
    bool "Widget for battery charge information, using small icons"
    depends on ZMK_BATTERY_REPORTING
    select LV_USE_LABEL

if ZMK_WIDGET_BATTERY_STATUS

config ZMK_WIDGET_BATTERY_STATUS_SHOW_PERCENTAGE
    bool "Show battery level percentage in text"

endif

config ZMK_WIDGET_OUTPUT_STATUS
    bool "Widget for keyboard output status icons"
    depends on BT && (!ZMK_SPLIT_BLE || ZMK_SPLIT_ROLE_CENTRAL)
    select LV_USE_LABEL

config ZMK_WIDGET_PERIPHERAL_STATUS
    bool "Widget for split peripheral status icons"
    depends on BT && ZMK_SPLIT_BLE && !ZMK_SPLIT_ROLE_CENTRAL
    select LV_USE_LABEL

config ZMK_WIDGET_WPM_STATUS
    bool "Widget for displaying typed words per minute"
    depends on !ZMK_SPLIT || ZMK_SPLIT_ROLE_CENTRAL
    select LV_USE_LABEL
    select ZMK_WPM

config ZMK_WIDGET_CPI_STATUS
    bool "Widget for displaying current CPI value"
    depends on !ZMK_SPLIT || ZMK_SPLIT_ROLE_CENTRAL
    select LV_USE_LABEL
    select ZMK_CPI

config ZMK_WIDGET_SYNC_LAYER_STATUS
    bool "Widget for displaying current highest layer on the peripheral"
    depends on ZMK_SPLIT && !ZMK_SPLIT_ROLE_CENTRAL && ZMK_SPLIT_PERIPHERAL_SYNC_STATE
    select LV_USE_LABEL
    select ZMK_SYNC_LAYER

config ZMK_WIDGET_SYNC_OUTPUT_STATUS
    bool "Widget for displaying keybaord output status on the peripheral"
    depends on ZMK_SPLIT && !ZMK_SPLIT_ROLE_CENTRAL && ZMK_SPLIT_PERIPHERAL_SYNC_STATE
    select LV_USE_LABEL
    select ZMK_SYNC_OUTPUT

config ZMK_WIDGET_SYNC_BATTERY_STATUS
    bool "Widget for displaying battery status of the central halve on the peripheral"
    depends on ZMK_SPLIT && !ZMK_SPLIT_ROLE_CENTRAL && ZMK_SPLIT_PERIPHERAL_SYNC_STATE
    select LV_USE_LABEL
    select ZMK_SYNC_BATTERY

endmenu
```
