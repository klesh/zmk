## app/boards/shields/ballkey_clunky/Kconfig.shield
```kconfig
config SHIELD_BALLKEY_CLUNKY
    def_bool $(shields_list_contains,ballkey_clunky)

config SHIELD_BALLKEY_CLUNKY_LEFT
    def_bool $(shields_list_contains,ballkey_clunky_left)
```

## app/boards/shields/pskeeb5_3x6/Kconfig.shield
```kconfig
# Copyright (c) 2020 Pete Johanson
# SPDX-License-Identifier: MIT

config SHIELD_PSKEEB5_3X6_LEFT
    def_bool $(shields_list_contains,pskeeb5_3x6_left)

config SHIELD_PSKEEB5_3X6_RIGHT
    def_bool $(shields_list_contains,pskeeb5_3x6_right)
```

## app/dts/bindings/zmk,physical-layout.yaml
```yaml
#
# Copyright (c) 2024 The ZMK Contributors
#
# SPDX-License-Identifier: MIT

description: |
  Describe the physical layout of a keyboard, including deps like the transform and kscan
  that are needed for that layout to work.

compatible: "zmk,physical-layout"

properties:
  display-name:
    type: string
    required: true
    description: The name of this layout to display in the UI
  transform:
    type: phandle
    required: true
    description: The matrix transform to use along with this layout.
  kscan:
    type: phandle
    description: The kscan to use along with this layout. The `zmk,kscan` chosen will be used as a fallback if this property is omitted.
  input:
    type: phandle
    description: The input device to use along with this layout. The `zmk,matrix-input` chosen will be used as a fallback if this property is omitted.
  keys:
    type: phandle-array
    description: Array of key physical attributes.
  sensor-key-positions:
    type: array
    description: |
      Key positions (indices into `keys`) of each sensor/encoder, in the same order as the
      `sensors` property of the keymap sensors node. Used by ZMK Studio to place the synthetic
      clockwise/counter-clockwise keys next to the physical encoder.
```

## app/module/dts/bindings/test-behaviors/zmk,behavior_get_sensor_binding.yaml
```yaml
# Copyright (c) 2026 The ZMK Contributors
# SPDX-License-Identifier: MIT

description: Sensor Binding Resolver Behavior

compatible: "zmk,behavior-get-sensor-binding"

include: two_param.yaml
```

## app/module/dts/bindings/test-behaviors/zmk,behavior_keymap_settings.yaml
```yaml
# Copyright (c) 2026 The ZMK Contributors
# SPDX-License-Identifier: MIT

description: Keymap Settings Control Behavior

compatible: "zmk,behavior-keymap-settings"

include: one_param.yaml
```

## app/west.yml
```yaml
manifest:
  remotes:
    - name: zephyrproject-rtos
      url-base: https://github.com/zephyrproject-rtos
    - name: zmkfirmware
      url-base: https://github.com/zmkfirmware
    - name: badjeff
      url-base: https://github.com/badjeff
    - name: infused-kim
      url-base: https://github.com/infused-kim
    - name: klesh
      url-base: https://github.com/klesh
  projects:
    - name: zephyr
      remote: zmkfirmware
      revision: v4.1.0+zmk-fixes
      clone-depth: 1
      import:
        name-blocklist:
          - ci-tools
          - hal_altera
          - hal_cypress
          - hal_infineon
          - hal_microchip
          - hal_nxp
          - hal_openisa
          - hal_xtensa
          - hal_st
          - hal_ti
          - loramac-node
          - mcuboot
          - mcumgr
          - net-tools
          - openthread
          - edtt
          - trusted-firmware-m
    - name: hal_stm32
      revision: 4fcc3a3f32abe1c4cb76d9d1cef967728dd03908
      path: modules/hal/stm32
      remote: zmkfirmware
      groups:
        - hal
    - name: lvgl
      revision: f1db87ee98f1810328a8419572fa42a3b5f352ae
      path: modules/lib/gui/lvgl
      remote: zmkfirmware
    - name: zmk-studio-messages
      revision: 6cb4c283e76209d59c45fbcb218800cd19e9339d
      path: modules/msgs/zmk-studio-messages
      remote: zmkfirmware
    - name: zmk-pmw3610-driver
      remote: badjeff
      revision: main
    - name: kb_zmk_ps2_mouse_trackpoint_driver
      remote: klesh
      revision: main
  group-filter: [+optional]
  self:
    west-commands: scripts/west-commands.yml
```
